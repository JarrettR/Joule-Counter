## CMakeLists.txt
```
# SPDX-License-Identifier: Apache-2.0

cmake_minimum_required(VERSION 3.20.0)

# The ppk2 board definition lives in this tree, not in Zephyr's.
list(APPEND BOARD_ROOT ${CMAKE_CURRENT_SOURCE_DIR})

find_package(Zephyr REQUIRED HINTS $ENV{ZEPHYR_BASE})
project(ppk2_firmware)

target_sources(app PRIVATE
	src/main.c
	src/board_io.c
	src/digipot.c
	src/metadata.c
	src/sampling.c
	src/power.c
	src/usb_ppk.c
	src/dfu.c
	src/protocol.c
	src/leds.c
	src/shell_cmds.c
)

# The sampling interrupt, the block packer and the CRC run for every sample
# at 100 kHz; the rest of the firmware stays size-optimised.
set_source_files_properties(src/sampling.c src/protocol.c PROPERTIES COMPILE_OPTIONS -O2)
```

## Kconfig
```
# SPDX-License-Identifier: Apache-2.0

mainmenu "Joule Counter firmware"

menu "PPK2"

config PPK2_USB_VID
	hex "USB vendor ID"
	default 0x1915
	help
	  The desktop Power Profiler app only lists devices carrying Nordic's
	  vendor ID (nrf-device-lib's "nordicUsb" trait).

config PPK2_USB_PID
	hex "USB product ID"
	default 0xC00A
	help
	  The desktop app recognises a PPK2 by idProduct == 0xC00A.

config PPK2_USB_MANUFACTURER
	string "USB manufacturer string"
	default "Nordic Semiconductor"

config PPK2_USB_PRODUCT
	string "USB product string"
	default "Joule Counter"

config PPK2_DFU_SEMVER
	string "Version string served on the DFU trigger interface"
	default "joule_counter 0.2.0"
	help
	  The app reads this string to decide whether it should offer to
	  reprogram the kit. This firmware's wire protocol has diverged from
	  the stock PPK2's (voltage stream, wider samples), so it identifies as
	  its own product rather than claiming to be a power_profiler_kit_2.
	  The default matches what Joule-Counter's DeviceSelector expects, so
	  the app leaves this firmware alone.

config PPK2_FW_VERSION_MAJOR
	int "Firmware major version reported in DFU info"
	default 1

config PPK2_FW_VERSION_MINOR
	int "Firmware minor version reported in DFU info"
	default 2

config PPK2_DEFAULT_VDD_MV
	int "Source-mode output voltage used when the EEPROM holds none (mV)"
	range 800 5000
	default 3000

config PPK2_SAMPLE_RING_SAMPLES
	int "Sample ring buffer depth (samples, power of two)"
	default 32768
	help
	  How long the host may stop reading before samples are lost: 32768
	  samples are 328 ms at 100 kHz. Each sample takes 33 bits of RAM, so
	  the default costs 132 KiB.

config PPK2_USB_TX_INFLIGHT
	int "Sample blocks queued to the USB controller at once"
	range 1 8
	default 4

config PPK2_STREAM_KEEPS_CPU_AWAKE
	bool "Skip WFI in the idle thread while the current stream runs"
	default y
	select ARM_ON_ENTER_CPU_IDLE_HOOK
	help
	  Waking the CPU from WFI takes about 12.5 us on this kit, longer than
	  the 10 us sample period, so an idle CPU services only every other
	  conversion. With this enabled the idle thread spins instead of
	  sleeping while sampling is active. The kit is USB powered and its own
	  consumption is not what it measures, so nothing is lost.

endmenu

source "Kconfig.zephyr"
```

## prj.conf
```kconfig
# Power Profiler Kit II firmware.
#
# The board supplies the LFCLK source, the bootloader-aware flash offset and
# the USB stack selection; this file asks for what the application uses.

CONFIG_LOG=y
CONFIG_LOG_DEFAULT_LEVEL=3

# Cortex-M4F: calibration maths and voltage conversion are floating point.
CONFIG_FPU=y

# The SAADC END handler runs as a zero-latency interrupt: it has 10 us to
# collect each result and must not wait behind irq_lock() sections in the USB
# driver. It makes no kernel calls; a TIMER3 compare interrupt signals blocks.
CONFIG_ZERO_LATENCY_IRQS=y

CONFIG_GPIO=y
CONFIG_I2C=y
CONFIG_EEPROM=y
CONFIG_PWM=y
CONFIG_LED=y
CONFIG_LED_PWM=y
CONFIG_HWINFO=y
CONFIG_REBOOT=y
CONFIG_CRC=y

# The metadata reply and the shell print floats with printf-style formatting.
CONFIG_PICOLIBC_IO_FLOAT=y
CONFIG_CBPRINTF_FP_SUPPORT=y

# USB: this application builds its own composite device (data port, shell
# port, DFU trigger), so the board's boot-time CDC ACM convenience must stay
# out of the way.
CONFIG_USB_DEVICE_STACK_NEXT=y
CONFIG_USBD_CDC_ACM_CLASS=y
CONFIG_CDC_ACM_SERIAL_INITIALIZE_AT_BOOT=n
# Sample blocks are 2128-byte bulk transfers (512 packed samples plus a
# header); several are in flight at once and the pool needs headroom beyond
# them for the metadata reply and the control/RX buffers, or allocations
# fail under load.
CONFIG_UDC_BUF_POOL_SIZE=16384
CONFIG_UDC_BUF_COUNT=32

CONFIG_SERIAL=y
CONFIG_CONSOLE=y
CONFIG_UART_CONSOLE=y
CONFIG_UART_LINE_CTRL=y
CONFIG_SHELL=y
CONFIG_SHELL_BACKEND_SERIAL=y
CONFIG_SHELL_BACKEND_SERIAL_CHECK_DTR=y
CONFIG_SHELL_PROMPT_UART="ppk2:~$ "

CONFIG_MAIN_STACK_SIZE=4096
CONFIG_SYSTEM_WORKQUEUE_STACK_SIZE=2048
CONFIG_HEAP_MEM_POOL_SIZE=8192
```

## src/metadata.c
```c
/*
 * Calibration metadata stored in the on-board EEPROM (U7).
 *
 * The EEPROM is the one copy of this unit's factory calibration, so writes
 * are field-wise, to offsets confirmed against the stock layout, and only
 * for values this firmware actually changes. Everything else in the stock
 * image is read and left alone.
 *
 * SPDX-License-Identifier: Apache-2.0
 */

#include <ctype.h>
#include <math.h>
#include <stdio.h>
#include <stdlib.h>
#include <string.h>

#include <zephyr/kernel.h>
#include <zephyr/device.h>
#include <zephyr/drivers/eeprom.h>
#include <zephyr/sys/byteorder.h>
#include <zephyr/sys/crc.h>
#include <zephyr/logging/log.h>

#include <nrfx.h>

#include "metadata.h"
#include "ppk2.h"
#include "sampling.h"

LOG_MODULE_REGISTER(metadata, CONFIG_LOG_DEFAULT_LEVEL);

/*
 * Our own backup lives clear of both stock regions: its primary image ends at
 * 0x100 and its backup copy (with a trailing CRC) occupies 0x600..0x702.
 */
#define BACKUP_OFFSET		0x200
#define BACKUP_MAGIC		0x324B5050	/* "PPK2" */
#define SAVE_DEBOUNCE		K_SECONDS(2)

#define IA_DEFAULT		128
#define IA_MAX			256

/*
 * Stock masks the range-0 gain terms when it reports them, whatever the
 * EEPROM holds (a real unit stored GS0 = -1138.7, GI0 = 1.03 and reported
 * 1e-19 and 1.0). The epsilon rather than zero matters: the desktop app
 * substitutes its own default of 1.0 for any value that parses as zero.
 */
#define REPORTED_GS0		1e-19f
#define REPORTED_GI0		1.0f

struct backup_image {
	uint32_t magic;
	struct ppk2_metadata meta;
	uint32_t crc;
} __packed;

static const struct device *const eeprom = DEVICE_DT_GET(DT_ALIAS(eeprom_0));

static struct ppk2_metadata meta;
/* What the EEPROM holds for the fields we own, so saves touch only changes. */
static struct ppk2_metadata stored;
static bool calibrated;
static bool ia_unknown;
static K_MUTEX_DEFINE(lock);

/*
 * Mirrors the desktop app's own fallbacks, which it substitutes for any key
 * that parses as zero. Sending anything else for an uncalibrated kit would
 * therefore be overridden anyway.
 */
static const struct ppk2_metadata defaults = {
	.r = { 1031.64f, 101.65f, 10.15f, 0.94f, 0.043f },
	.gs = { 1.0f, 1.0f, 1.0f, 1.0f, 1.0f },
	.gi = { 1.0f, 1.0f, 1.0f, 1.0f, 1.0f },
	.ug = { 1.0f, 1.0f, 1.0f, 1.0f, 1.0f },
	.vdd = CONFIG_PPK2_DEFAULT_VDD_MV,
	.mode = PPK2_MODE_AMPERE,
	.calibrated = 0,
	.ia = IA_DEFAULT,
};

static uint16_t derived_hw(void)
{
	/* Stock reports the low 16 bits of DEVICEID[0] as a decimal integer;
	 * a real unit confirmed the field and its width.
	 */
	return (uint16_t)(NRF_FICR->DEVICEID[0] & 0xFFFFU);
}

static bool all_finite(const float *v, size_t n)
{
	for (size_t k = 0; k < n; k++) {
		if (!isfinite(v[k])) {
			return false;
		}
	}

	return true;
}

static bool resistances_plausible(const float *r)
{
	for (size_t k = 0; k < PPK2_RANGE_COUNT; k++) {
		if (!isfinite(r[k]) || r[k] <= 0.001f || r[k] > 100000.0f) {
			return false;
		}
	}

	return true;
}

static void decode_image(const uint8_t *img, struct ppk2_metadata *m)
{
	memcpy(m->r, &img[EEPROM_OFF_R], sizeof(m->r));
	memcpy(m->gs, &img[EEPROM_OFF_GS], sizeof(m->gs));
	memcpy(m->o, &img[EEPROM_OFF_O], sizeof(m->o));
	memcpy(m->s, &img[EEPROM_OFF_S], sizeof(m->s));
	memcpy(m->i, &img[EEPROM_OFF_I], sizeof(m->i));
	memcpy(m->gi, &img[EEPROM_OFF_GI], sizeof(m->gi));
	memcpy(m->ug, &img[EEPROM_OFF_UG], sizeof(m->ug));
	m->vdd = sys_get_le16(&img[EEPROM_OFF_VDD]);
	m->mode = img[EEPROM_OFF_MODE];
	m->calibrated = img[EEPROM_OFF_CALIBRATED];
	m->ia = sys_get_le16(&img[EEPROM_OFF_IA]);
	m->hw = derived_hw();
}

static void sanitize(struct ppk2_metadata *m)
{
	if (!all_finite(m->gs, PPK2_RANGE_COUNT)) {
		memcpy(m->gs, defaults.gs, sizeof(m->gs));
	}
	if (!all_finite(m->gi, PPK2_RANGE_COUNT)) {
		memcpy(m->gi, defaults.gi, sizeof(m->gi));
	}
	if (!all_finite(m->o, PPK2_RANGE_COUNT)) {
		memset(m->o, 0, sizeof(m->o));
	}
	if (!all_finite(m->s, PPK2_RANGE_COUNT)) {
		memset(m->s, 0, sizeof(m->s));
	}
	if (!all_finite(m->i, PPK2_RANGE_COUNT)) {
		memset(m->i, 0, sizeof(m->i));
	}
	if (!all_finite(m->ug, PPK2_RANGE_COUNT)) {
		memcpy(m->ug, defaults.ug, sizeof(m->ug));
	}
	for (size_t k = 0; k < PPK2_RANGE_COUNT; k++) {
		if (m->ug[k] <= 0.0f || m->ug[k] > 10.0f) {
			m->ug[k] = 1.0f;
		}
	}

	if (m->vdd < 800 || m->vdd > 5000) {
		m->vdd = CONFIG_PPK2_DEFAULT_VDD_MV;
	}
	if (m->mode != PPK2_MODE_AMPERE && m->mode != PPK2_MODE_SOURCE) {
		m->mode = PPK2_MODE_AMPERE;
	}
	if (m->calibrated > 1) {
		m->calibrated = 0;
	}

	/* Fresh EEPROM reads 0xFFFF here, and the one real unit seen so far
	 * held a value far beyond the wiper's range in its stock backup.
	 */
	ia_unknown = m->ia > IA_MAX;
	if (ia_unknown) {
		LOG_WRN("no usable IA wiper value in EEPROM (%u), will trim", m->ia);
		m->ia = IA_DEFAULT;
	}
}

void metadata_load_defaults(void)
{
	k_mutex_lock(&lock, K_FOREVER);
	meta = defaults;
	meta.hw = derived_hw();
	calibrated = false;
	ia_unknown = true;
	k_mutex_unlock(&lock);
}

int metadata_init(void)
{
	uint8_t img[EEPROM_STOCK_IMAGE_SIZE];
	int ret;

	if (!device_is_ready(eeprom)) {
		LOG_ERR("EEPROM not ready");
		metadata_load_defaults();
		return -ENODEV;
	}

	ret = eeprom_read(eeprom, 0, img, sizeof(img));
	if (ret < 0) {
		LOG_ERR("EEPROM read failed: %d", ret);
		metadata_load_defaults();
		return ret;
	}

	k_mutex_lock(&lock, K_FOREVER);
	decode_image(img, &meta);
	stored = meta;

	if (resistances_plausible(meta.r)) {
		calibrated = true;
		sanitize(&meta);
		LOG_INF("calibration loaded: R0=%.2f R4=%.4f vdd=%u mode=%u ia=%u flag=%u",
			(double)meta.r[0], (double)meta.r[4], meta.vdd, meta.mode, meta.ia,
			meta.calibrated);
	} else {
		LOG_WRN("EEPROM holds no usable calibration, using defaults");
		meta = defaults;
		meta.hw = derived_hw();
		calibrated = false;
		ia_unknown = true;
	}
	k_mutex_unlock(&lock);

	return 0;
}

struct ppk2_metadata *metadata_get(void)
{
	return &meta;
}

bool metadata_is_calibrated(void)
{
	return calibrated;
}

bool metadata_ia_unknown(void)
{
	return ia_unknown;
}

static int write_if_changed(size_t offset, const void *now, void *was, size_t len)
{
	if (memcmp(now, was, len) == 0) {
		return 0;
	}

	int ret = eeprom_write(eeprom, offset, now, len);

	if (ret == 0) {
		memcpy(was, now, len);
	} else {
		LOG_ERR("EEPROM write at %u failed: %d", (unsigned int)offset, ret);
	}

	return ret;
}

int metadata_save(void)
{
	struct ppk2_metadata m;
	uint8_t le16[2];
	int ret;

	if (!device_is_ready(eeprom)) {
		return -ENODEV;
	}

	k_mutex_lock(&lock, K_FOREVER);
	m = meta;

	sys_put_le16(m.vdd, le16);
	ret = write_if_changed(EEPROM_OFF_VDD, le16, &stored.vdd, sizeof(le16));
	stored.vdd = m.vdd;

	if (ret == 0) {
		ret = write_if_changed(EEPROM_OFF_UG, m.ug, stored.ug, sizeof(m.ug));
	}
	if (ret == 0) {
		ret = write_if_changed(EEPROM_OFF_MODE, &m.mode, &stored.mode, sizeof(m.mode));
	}
	if (ret == 0) {
		sys_put_le16(m.ia, le16);
		ret = write_if_changed(EEPROM_OFF_IA, le16, &stored.ia, sizeof(le16));
		stored.ia = m.ia;
	}
	k_mutex_unlock(&lock);

	return ret;
}

static void save_work_handler(struct k_work *work)
{
	ARG_UNUSED(work);
	metadata_save();
}

static K_WORK_DELAYABLE_DEFINE(save_work, save_work_handler);

void metadata_save_deferred(void)
{
	k_work_reschedule(&save_work, SAVE_DEBOUNCE);
}

int metadata_backup_write(void)
{
	struct backup_image img;

	if (!device_is_ready(eeprom)) {
		return -ENODEV;
	}

	k_mutex_lock(&lock, K_FOREVER);
	img.magic = BACKUP_MAGIC;
	img.meta = meta;
	k_mutex_unlock(&lock);
	img.crc = crc32_ieee((const uint8_t *)&img.meta, sizeof(img.meta));

	return eeprom_write(eeprom, BACKUP_OFFSET, &img, sizeof(img));
}

static int backup_read(struct backup_image *img)
{
	int ret;

	if (!device_is_ready(eeprom)) {
		return -ENODEV;
	}

	ret = eeprom_read(eeprom, BACKUP_OFFSET, img, sizeof(*img));
	if (ret < 0) {
		return ret;
	}

	if (img->magic != BACKUP_MAGIC ||
	    img->crc != crc32_ieee((const uint8_t *)&img->meta, sizeof(img->meta))) {
		return -EBADMSG;
	}

	return 0;
}

int metadata_backup_valid(void)
{
	struct backup_image img;

	return backup_read(&img);
}

/*
 * Restores only what this firmware owns. The factory constants are not
 * rewritten from our backup: if they were lost, stock's own backup copy at
 * 0x600 is the authoritative source, not ours.
 */
int metadata_backup_restore(void)
{
	struct backup_image img;
	int ret = backup_read(&img);

	if (ret < 0) {
		return ret;
	}

	k_mutex_lock(&lock, K_FOREVER);
	memcpy(meta.ug, img.meta.ug, sizeof(meta.ug));
	meta.vdd = img.meta.vdd;
	meta.mode = img.meta.mode;
	meta.ia = img.meta.ia;
	k_mutex_unlock(&lock);

	return metadata_save();
}

/*
 * The desktop app lower-cases this text, turns every "key: value" line into a
 * JSON member and parses the result, so the values must be plain numbers:
 * never NaN or infinity.
 */
size_t metadata_format(char *buf, size_t size)
{
	struct ppk2_metadata m;
	size_t pos = 0;

	k_mutex_lock(&lock, K_FOREVER);
	m = meta;
	k_mutex_unlock(&lock);

	m.gs[0] = REPORTED_GS0;
	m.gi[0] = REPORTED_GI0;

#define PUT(...)								\
	do {									\
		int n_ = snprintf(buf + pos, size - pos, __VA_ARGS__);		\
		if (n_ < 0 || (size_t)n_ >= size - pos) {			\
			return 0;						\
		}								\
		pos += (size_t)n_;						\
	} while (0)

	PUT("Calibrated: %u\n", m.calibrated);
	for (int k = 0; k < PPK2_RANGE_COUNT; k++) {
		PUT("R%d: %.20f\n", k, (double)m.r[k]);
	}
	for (int k = 0; k < PPK2_RANGE_COUNT; k++) {
		PUT("GS%d: %.20f\n", k, (double)m.gs[k]);
	}
	for (int k = 0; k < PPK2_RANGE_COUNT; k++) {
		PUT("GI%d: %.20f\n", k, (double)m.gi[k]);
	}
	for (int k = 0; k < PPK2_RANGE_COUNT; k++) {
		PUT("O%d: %.20f\n", k, (double)m.o[k]);
	}
	PUT("VDD: %u\n", m.vdd);
	PUT("HW: %u\n", m.hw);
	PUT("mode: %u\n", m.mode);
	for (int k = 0; k < PPK2_RANGE_COUNT; k++) {
		PUT("S%d: %.20f\n", k, (double)m.s[k]);
	}
	for (int k = 0; k < PPK2_RANGE_COUNT; k++) {
		PUT("I%d: %.20f\n", k, (double)m.i[k]);
	}
	for (int k = 0; k < PPK2_RANGE_COUNT; k++) {
		PUT("UG%d: %.20f\n", k, (double)m.ug[k]);
	}
	PUT("IA: %u\n", m.ia);

	/* Joule Counter additions: how to scale the stream's voltage field,
	 * the sample rate and the block format, so the host carries no copy
	 * of any of them.
	 */
	float vfs, vdiv;

	sampling_voltage_scale(&vfs, &vdiv);
	PUT("VFS: %.1f\n", (double)vfs);
	PUT("VDIV: %.3f\n", (double)vdiv);
	PUT("SampleRate: %u\n", PPK2_SAMPLE_RATE_HZ);
	PUT("BlockFormat: %u\n", PPK2_BLOCK_VERSION);
	PUT("END\n");
#undef PUT

	return pos;
}

static float *float_array(struct ppk2_metadata *m, const char *name)
{
	if (strcmp(name, "r") == 0) {
		return m->r;
	}
	if (strcmp(name, "gs") == 0) {
		return m->gs;
	}
	if (strcmp(name, "gi") == 0) {
		return m->gi;
	}
	if (strcmp(name, "o") == 0) {
		return m->o;
	}
	if (strcmp(name, "s") == 0) {
		return m->s;
	}
	if (strcmp(name, "i") == 0) {
		return m->i;
	}
	if (strcmp(name, "ug") == 0) {
		return m->ug;
	}

	return NULL;
}

/*
 * Edits the in-RAM copy only. Factory constants (r, gs, gi, o, s, i) can be
 * edited here for experiments but are never persisted by metadata_save().
 */
int metadata_set(const char *key, const char *value)
{
	char name[8];
	size_t n = 0;
	int ret = 0;

	while (key[n] != '\0' && !isdigit((unsigned char)key[n]) && n < sizeof(name) - 1) {
		name[n] = (char)tolower((unsigned char)key[n]);
		n++;
	}
	name[n] = '\0';

	k_mutex_lock(&lock, K_FOREVER);

	if (key[n] != '\0') {
		float *arr = float_array(&meta, name);
		int idx = atoi(&key[n]);

		if (arr == NULL || idx < 0 || idx >= PPK2_RANGE_COUNT) {
			ret = -EINVAL;
		} else {
			float v = strtof(value, NULL);

			if (!isfinite(v)) {
				ret = -EINVAL;
			} else {
				arr[idx] = v;
				if (arr == meta.r) {
					calibrated = resistances_plausible(meta.r);
				}
			}
		}
	} else if (strcmp(name, "vdd") == 0) {
		meta.vdd = (uint16_t)strtoul(value, NULL, 0);
	} else if (strcmp(name, "mode") == 0) {
		meta.mode = (uint8_t)strtoul(value, NULL, 0);
	} else if (strcmp(name, "ia") == 0) {
		meta.ia = (uint16_t)strtoul(value, NULL, 0);
		ia_unknown = false;
	} else {
		ret = -EINVAL;
	}

	k_mutex_unlock(&lock);

	return ret;
}

int metadata_raw_read(size_t offset, uint8_t *buf, size_t len)
{
	if (!device_is_ready(eeprom)) {
		return -ENODEV;
	}

	return eeprom_read(eeprom, offset, buf, len);
}
```

## src/ppk2.h
```c
/*
 * Definitions shared across the PPK2 firmware.
 *
 * The wire format here is shared with the Joule-Counter desktop app
 * (Joule-Counter/src/device/blockParser.ts, serialDevice.ts) and with
 * tools/ppk_protocol.py; change them together.
 *
 * SPDX-License-Identifier: Apache-2.0
 */

#ifndef PPK2_H_
#define PPK2_H_

#include <stdint.h>

#include <zephyr/sys/util.h>

/*
 * One SAADC scan of both channels per period. 100 kHz is where the scan
 * tops out (two conversions in 10 us); the packed stream below carries it
 * at about 415 kB/s, the same link load as the stock one-word format.
 */
#define PPK2_SAMPLE_RATE_HZ	100000U
#define PPK2_BLOCK_SAMPLES	512U
#define PPK2_RANGE_COUNT	5U

/* Range field values other than 0..4. */
#define PPK2_RANGE_MISSING	6U	/* a conversion the sampler never saw */
#define PPK2_RANGE_SWITCHING	7U	/* the switches were between two ranges */

/*
 * The stream is a sequence of blocks, one USB transfer each: a 24-byte
 * struct ppk2_block_header, then the block's samples as one bit stream.
 *
 * A sample has four fields, all of them information:
 *
 *   current  0..2047  the 14-bit differential SAADC result shifted right by
 *                     two, clamped. The host multiplies it back by four, so
 *                     the calibration constants in the EEPROM are in raw
 *                     14-bit counts.
 *   range    0..7     0..4, PPK2_RANGE_SWITCHING or PPK2_RANGE_MISSING.
 *   voltage  0..2047  VDUT, same convention as the current (uncalibrated
 *                     linear divider/gain maths on the host).
 *   logic    0..255   logic port D0..D7.
 *
 * Each block stores every field as its offset from the block's smallest
 * value (base), in just enough bits for the block's spread (width): a quiet
 * signal needs a few bits a sample, a busy one at most 11 + 3 + 11 + 8 = 33,
 * which bounds the link load. Sample k occupies bits k*W .. k*W+W-1 of the
 * payload, W being the sum of the widths, fields in the order above, least
 * significant bit first, in 32-bit little-endian words zero-padded at the
 * end.
 *
 * Every conversion slot of a stream has an index, counting from zero at
 * AverageStart; the header names the index of the block's first sample and
 * the samples of a block are consecutive slots. Anything the device could
 * not deliver therefore shows up on the host as a gap between blocks, of
 * exactly the right length, and switching or missed conversions keep their
 * slot, so the time base never drifts.
 */
#define PPK2_SAMPLE_VALUE_MAX	0x7FFU

enum ppk2_field {
	PPK2_FIELD_CURRENT,
	PPK2_FIELD_RANGE,
	PPK2_FIELD_VOLTAGE,
	PPK2_FIELD_LOGIC,
	PPK2_FIELD_COUNT,
};

/* Width of each field at full resolution. */
#define PPK2_FIELD_BITS		{ 11U, 3U, 11U, 8U }
#define PPK2_SAMPLE_BITS_MAX	33U

#define PPK2_BLOCK_MAGIC0	'J'
#define PPK2_BLOCK_MAGIC1	'C'
#define PPK2_BLOCK_VERSION	1U

/* Block header flags. */
#define PPK2_BLOCK_EXT_USB	BIT(0)	/* J1 VBUS present when the block was sent */
#define PPK2_BLOCK_LAST		BIT(1)	/* the stream stopped; nothing follows */
#define PPK2_BLOCK_OVERFLOW	BIT(2)	/* the gap before this block is a ring overflow */
#define PPK2_BLOCK_TEST		BIT(3)	/* link test pattern, not measurements */

struct ppk2_block_header {
	uint8_t magic[2];
	uint8_t version;
	uint8_t flags;
	uint32_t first;		/* stream index of the first sample */
	uint16_t count;		/* samples in this block, 0..PPK2_BLOCK_SAMPLES */
	uint8_t stream;		/* changes with every AverageStart */
	uint8_t reserved;
	uint16_t current_base;
	uint16_t voltage_base;
	uint8_t range_base;
	uint8_t logic_base;
	uint8_t widths_cv;	/* current width | voltage width << 4 */
	uint8_t widths_rl;	/* range width | logic width << 4 */
	uint32_t crc;		/* CRC-32 (zlib) of bytes 0..19, then the payload */
} __packed;

BUILD_ASSERT(sizeof(struct ppk2_block_header) == 24);

#define PPK2_BLOCK_PAYLOAD_WORDS(n, bits)	DIV_ROUND_UP((n) * (bits), 32U)
#define PPK2_BLOCK_BYTES_MAX	(sizeof(struct ppk2_block_header) + \
				 4U * PPK2_BLOCK_PAYLOAD_WORDS(PPK2_BLOCK_SAMPLES, \
							       PPK2_SAMPLE_BITS_MAX))

enum ppk2_mode {
	PPK2_MODE_AMPERE = 1,
	PPK2_MODE_SOURCE = 2,
};

/* Commands the host may send on the data port, one opcode byte each. */
enum ppk2_cmd {
	PPK2_CMD_TRIGGER_SET		= 0x01,
	PPK2_CMD_AVG_NUM_SET		= 0x02,
	PPK2_CMD_TRIGGER_WINDOW_SET	= 0x03,
	PPK2_CMD_TRIGGER_INTERVAL_SET	= 0x04,
	PPK2_CMD_TRIGGER_SINGLE_SET	= 0x05,
	PPK2_CMD_AVERAGE_START		= 0x06,
	PPK2_CMD_AVERAGE_STOP		= 0x07,
	PPK2_CMD_RANGE_SET		= 0x08,
	PPK2_CMD_LCD_SET		= 0x09,
	PPK2_CMD_TRIGGER_STOP		= 0x0A,
	PPK2_CMD_DEVICE_RUNNING_SET	= 0x0C,
	PPK2_CMD_REGULATOR_SET		= 0x0D,
	PPK2_CMD_SWITCH_POINT_DOWN	= 0x0E,
	PPK2_CMD_SWITCH_POINT_UP	= 0x0F,
	PPK2_CMD_SET_POWER_MODE		= 0x11,
	PPK2_CMD_RES_USER_SET		= 0x12,
	PPK2_CMD_SPIKE_FILTERING_ON	= 0x15,
	PPK2_CMD_SPIKE_FILTERING_OFF	= 0x16,
	PPK2_CMD_GET_METADATA		= 0x19,
	PPK2_CMD_RESET			= 0x20,
	PPK2_CMD_SET_USER_GAINS		= 0x25,
	PPK2_CMD_LINK_TEST		= 0x30,
};

#endif /* PPK2_H_ */
```

## src/protocol.c
```c
/*
 * PPK2 host protocol on the USB data port.
 *
 * Commands arrive as an opcode byte followed by a fixed number of argument
 * bytes. Replies are either the metadata text (terminated by "END") or the
 * binary block stream (see ppk2.h), never both at once.
 *
 * SPDX-License-Identifier: Apache-2.0
 */

#include <math.h>
#include <stddef.h>
#include <string.h>

#include <zephyr/kernel.h>
#include <zephyr/net_buf.h>
#include <zephyr/sys/byteorder.h>
#include <zephyr/sys/reboot.h>
#include <zephyr/logging/log.h>

#include "board_io.h"
#include "metadata.h"
#include "power.h"
#include "ppk2.h"
#include "protocol.h"
#include "sampling.h"
#include "usb_ppk.h"

LOG_MODULE_REGISTER(protocol, CONFIG_LOG_DEFAULT_LEVEL);

#define CMD_MAX_ARGS		5
#define CMD_QUEUE_DEPTH		16
#define CMD_INTERNAL_LINK	0xFE	/* data port connected / disconnected */

/*
 * How long the pump waits for a free transfer slot before it looks at the
 * stream state again. Waiting loses nothing by itself: the ring keeps
 * filling, and if the host stays away long enough to overflow it, the loss
 * is accounted exactly.
 */
#define TX_BLOCK_TIMEOUT	K_MSEC(100)
#define TX_TEXT_TIMEOUT		K_MSEC(500)

/* Longest a stop waits for the stream's tail and final block to go out. */
#define FLUSH_TIMEOUT		K_MSEC(500)

#define LINK_TEST_MAX_SECONDS	60U

#define BLOCK_BYTES_MAX		PPK2_BLOCK_BYTES_MAX
#define BLOCK_HEADER_SIZE	sizeof(struct ppk2_block_header)

struct cmd {
	uint8_t op;
	uint8_t len;
	uint8_t arg[CMD_MAX_ARGS];
};

/* Argument byte count per opcode; -1 marks opcodes this firmware does not know. */
static const int8_t cmd_arg_len[0x31] = {
	[0 ... 0x30] = -1,
	[PPK2_CMD_TRIGGER_SET] = 2,
	[PPK2_CMD_AVG_NUM_SET] = 1,
	[PPK2_CMD_TRIGGER_WINDOW_SET] = 2,
	[PPK2_CMD_TRIGGER_INTERVAL_SET] = 1,
	[PPK2_CMD_TRIGGER_SINGLE_SET] = 0,
	[PPK2_CMD_AVERAGE_START] = 0,
	[PPK2_CMD_AVERAGE_STOP] = 0,
	[PPK2_CMD_RANGE_SET] = 1,
	[PPK2_CMD_LCD_SET] = 1,
	[PPK2_CMD_TRIGGER_STOP] = 0,
	[PPK2_CMD_DEVICE_RUNNING_SET] = 1,
	[PPK2_CMD_REGULATOR_SET] = 2,
	[PPK2_CMD_SWITCH_POINT_DOWN] = 1,
	[PPK2_CMD_SWITCH_POINT_UP] = 1,
	[PPK2_CMD_SET_POWER_MODE] = 1,
	[PPK2_CMD_RES_USER_SET] = 3,
	[PPK2_CMD_SPIKE_FILTERING_ON] = 0,
	[PPK2_CMD_SPIKE_FILTERING_OFF] = 0,
	[PPK2_CMD_GET_METADATA] = 0,
	[PPK2_CMD_RESET] = 0,
	[PPK2_CMD_SET_USER_GAINS] = 5,
	[PPK2_CMD_LINK_TEST] = 1,
};

K_MSGQ_DEFINE(cmd_q, sizeof(struct cmd), CMD_QUEUE_DEPTH, 4);

/*
 * Serialises everything that goes out on the data port: a block is
 * allocated, packed and queued under it, so an abort or a text reply never
 * lands between the steps of one.
 */
static K_MUTEX_DEFINE(tx_lock);

static volatile bool streaming;
static uint8_t stream_id;
static struct protocol_stats stats;

/* The pump gives this once a stopped stream has gone out completely. */
static K_SEM_DEFINE(flushed, 0, 1);

/* Link test: the pump sends test blocks until link_test_end (uptime, ms),
 * pseudo-random packed samples when link_test_pack is set.
 */
#define LINK_TEST_PACK		BIT(7)
static volatile bool link_test_active;
static volatile bool link_test_pack;
static volatile bool link_test_busy;
static volatile int64_t link_test_end;

/* Parser state, touched only from the USB receive context. */
static struct cmd partial;
static bool partial_active;

/* ---- block framing ----------------------------------------------------- */

static uint32_t crc_table[256];

static void crc_init(void)
{
	for (uint32_t n = 0; n < ARRAY_SIZE(crc_table); n++) {
		uint32_t c = n;

		for (int k = 0; k < 8; k++) {
			c = (c & 1U) ? 0xEDB88320U ^ (c >> 1) : c >> 1;
		}
		crc_table[n] = c;
	}
}

/* CRC-32 as zlib computes it; block_crc32(block_crc32(0, a), b) covers a then b. */
static uint32_t block_crc32(uint32_t crc, const uint8_t *data, size_t len)
{
	crc = ~crc;
	while (len-- > 0) {
		crc = crc_table[(crc ^ *data++) & 0xFFU] ^ (crc >> 8);
	}

	return ~crc;
}

/* Payload of a block being built, right behind its header. */
static uint32_t *block_payload(struct net_buf *buf)
{
	return (uint32_t *)(buf->data + BLOCK_HEADER_SIZE);
}

/* Fills in the header of a block whose payload is in place, and sizes it. */
static void block_seal(struct net_buf *buf, uint8_t flags, const struct sampling_block *blk)
{
	struct ppk2_block_header *h = (struct ppk2_block_header *)buf->data;
	size_t payload = 4U * blk->words;
	uint32_t crc;

	h->magic[0] = PPK2_BLOCK_MAGIC0;
	h->magic[1] = PPK2_BLOCK_MAGIC1;
	h->version = PPK2_BLOCK_VERSION;
	h->flags = flags;
	h->first = sys_cpu_to_le32(blk->first);
	h->count = sys_cpu_to_le16(blk->count);
	h->stream = stream_id;
	h->reserved = 0;
	h->current_base = sys_cpu_to_le16(blk->base[PPK2_FIELD_CURRENT]);
	h->voltage_base = sys_cpu_to_le16(blk->base[PPK2_FIELD_VOLTAGE]);
	h->range_base = (uint8_t)blk->base[PPK2_FIELD_RANGE];
	h->logic_base = (uint8_t)blk->base[PPK2_FIELD_LOGIC];
	h->widths_cv = blk->width[PPK2_FIELD_CURRENT] | (blk->width[PPK2_FIELD_VOLTAGE] << 4);
	h->widths_rl = blk->width[PPK2_FIELD_RANGE] | (blk->width[PPK2_FIELD_LOGIC] << 4);

	crc = block_crc32(0, buf->data, offsetof(struct ppk2_block_header, crc));
	crc = block_crc32(crc, (const uint8_t *)block_payload(buf), payload);
	h->crc = sys_cpu_to_le32(crc);

	net_buf_add(buf, BLOCK_HEADER_SIZE + payload);
}

/* ---- command intake ---------------------------------------------------- */

static void rx_handler(const uint8_t *data, size_t len)
{
	for (size_t k = 0; k < len; k++) {
		uint8_t b = data[k];

		if (!partial_active) {
			int8_t n = b < ARRAY_SIZE(cmd_arg_len) ? cmd_arg_len[b] : -1;

			if (n < 0) {
				stats.unknown_bytes++;
				continue;
			}

			partial.op = b;
			partial.len = 0;
			partial_active = true;
			if (n > 0) {
				continue;
			}
		} else {
			partial.arg[partial.len++] = b;
			if (partial.len < cmd_arg_len[partial.op]) {
				continue;
			}
		}

		partial_active = false;
		if (k_msgq_put(&cmd_q, &partial, K_NO_WAIT) != 0) {
			LOG_WRN("command queue full, dropped 0x%02x", partial.op);
		}
	}
}

static void link_handler(bool connected)
{
	struct cmd c = { .op = CMD_INTERNAL_LINK, .len = 1, .arg = { connected } };

	k_msgq_put(&cmd_q, &c, K_NO_WAIT);
}

/* ---- stream control ---------------------------------------------------- */

static void link_test_stop(void)
{
	link_test_active = false;
	while (link_test_busy) {
		k_sleep(K_MSEC(5));
	}
}

static void stream_start(void)
{
	if (streaming) {
		return;
	}

	link_test_stop();

	/* Set before the sampler runs, so the pump never mistakes the first
	 * samples of this stream for leftovers.
	 */
	stream_id++;
	streaming = true;

	int ret = sampling_start();

	if (ret < 0) {
		streaming = false;
		LOG_ERR("cannot start sampling: %d", ret);
		return;
	}

	LOG_INF("streaming");
}

/* Stops the stream and waits for its tail and final block to go out. */
static void stream_stop(void)
{
	if (!streaming) {
		return;
	}

	k_sem_reset(&flushed);
	sampling_stop();
	if (k_sem_take(&flushed, FLUSH_TIMEOUT) != 0) {
		stats.flush_timeouts++;
		LOG_WRN("stream tail not delivered");
		sampling_discard();
	}

	streaming = false;
	power_on_stream_stopped();
	LOG_INF("stopped");
}

/* The host went away: stop at once and drop whatever is still queued. */
static void stream_abort(void)
{
	link_test_stop();

	if (streaming) {
		streaming = false;
		sampling_stop();
		sampling_discard();
		power_on_stream_stopped();
		LOG_INF("stopped, host gone");
	}

	/* Anything left in the controller would reach the next reader of
	 * the port ahead of its metadata.
	 */
	k_mutex_lock(&tx_lock, K_FOREVER);
	usb_ppk_data_abort();
	k_mutex_unlock(&tx_lock);
}

static void send_text(const char *text, size_t len)
{
	k_mutex_lock(&tx_lock, K_FOREVER);
	while (len > 0) {
		size_t chunk = MIN(len, 1024U);
		int ret = usb_ppk_data_send((const uint8_t *)text, chunk, TX_TEXT_TIMEOUT);

		if (ret != 0) {
			stats.tx_failures++;
			LOG_WRN("metadata send failed: %d", ret);
			break;
		}
		text += chunk;
		len -= chunk;
	}
	k_mutex_unlock(&tx_lock);
}

static void handle_get_metadata(void)
{
	static char text[METADATA_TEXT_SIZE];

	/* The host expects only text until it has seen END. */
	link_test_stop();
	stream_stop();

	size_t len = metadata_format(text, sizeof(text));

	if (len == 0) {
		LOG_ERR("metadata does not fit its buffer");
		return;
	}

	send_text(text, len);
}

static void handle_set_user_gains(const uint8_t *arg)
{
	uint8_t range = arg[0];
	float gain;

	/* The app serialises the gain as a native little-endian float32. */
	memcpy(&gain, &arg[1], sizeof(gain));

	if (range >= PPK2_RANGE_COUNT || !isfinite(gain) || gain <= 0.0f) {
		LOG_WRN("rejected user gain %u", range);
		return;
	}

	metadata_get()->ug[range] = gain;
	metadata_save_deferred();
}

static void handle_link_test(uint8_t arg)
{
	uint8_t seconds = arg & ~LINK_TEST_PACK;

	if (seconds == 0) {
		link_test_stop();
		return;
	}
	if (streaming) {
		LOG_WRN("link test refused while streaming");
		return;
	}

	link_test_end = k_uptime_get() + 1000LL * MIN(seconds, LINK_TEST_MAX_SECONDS);
	link_test_pack = (arg & LINK_TEST_PACK) != 0;
	link_test_active = true;
}

static void dispatch(const struct cmd *c)
{
	stats.commands++;

	switch (c->op) {
	case CMD_INTERNAL_LINK:
		if (!c->arg[0]) {
			/* The DUT output is left as it was; the app turns it off
			 * itself on a clean close, and a USB hiccup should not cut
			 * the DUT's power.
			 */
			stream_abort();
		}
		break;

	case PPK2_CMD_AVERAGE_START:
		stream_start();
		break;

	case PPK2_CMD_AVERAGE_STOP:
		stream_stop();
		break;

	case PPK2_CMD_DEVICE_RUNNING_SET:
		power_set_output(c->arg[0] != 0);
		break;

	case PPK2_CMD_REGULATOR_SET:
		power_set_vdd((uint16_t)((c->arg[0] << 8) | c->arg[1]));
		break;

	case PPK2_CMD_SET_POWER_MODE:
		power_set_mode(c->arg[0]);
		break;

	case PPK2_CMD_GET_METADATA:
		handle_get_metadata();
		break;

	case PPK2_CMD_SET_USER_GAINS:
		handle_set_user_gains(c->arg);
		break;

	case PPK2_CMD_LINK_TEST:
		handle_link_test(c->arg[0]);
		break;

	case PPK2_CMD_RESET:
		stream_stop();
		power_set_output(false);
		k_sleep(K_MSEC(100));
		sys_reboot(SYS_REBOOT_COLD);
		break;

	default:
		/* PPK1-era commands: accepted for compatibility, no effect. */
		break;
	}
}

static void command_thread(void *p1, void *p2, void *p3)
{
	struct cmd c;

	ARG_UNUSED(p1);
	ARG_UNUSED(p2);
	ARG_UNUSED(p3);

	for (;;) {
		if (k_msgq_get(&cmd_q, &c, K_FOREVER) == 0) {
			dispatch(&c);
		}
	}
}

/* ---- sending ----------------------------------------------------------- */

/*
 * Sends the next block of the stream, packed straight into a USB buffer.
 * Returns false when there is nothing to do until more samples arrive.
 */
static bool pump_block(void)
{
	struct sampling_block blk;
	struct net_buf *buf;
	bool more = true;
	int err;

	k_mutex_lock(&tx_lock, K_FOREVER);

	if (!streaming || !sampling_block_ready()) {
		k_mutex_unlock(&tx_lock);
		return false;
	}

	buf = usb_ppk_data_alloc(BLOCK_BYTES_MAX, TX_BLOCK_TIMEOUT, &err);
	if (buf == NULL) {
		if (err == -EAGAIN) {
			/* The host is not reading; keep the samples and retry. */
			stats.tx_stalls++;
		} else {
			/* Nobody will read these. */
			stats.tx_failures++;
			sampling_discard();
			more = false;
		}
		k_mutex_unlock(&tx_lock);
		return more;
	}

	if (!sampling_take_block(block_payload(buf), &blk)) {
		usb_ppk_data_free(buf);
		k_mutex_unlock(&tx_lock);
		return sampling_block_ready();
	}

	uint8_t flags = (blk.overflow ? PPK2_BLOCK_OVERFLOW : 0U) |
			(blk.last ? PPK2_BLOCK_LAST : 0U) |
			(board_io_ext_usb_present() ? PPK2_BLOCK_EXT_USB : 0U);

	block_seal(buf, flags, &blk);

	size_t len = buf->len;

	if (usb_ppk_data_submit(buf) == 0) {
		sampling_count_block_sent();
		stats.bytes_sent += len;
	} else {
		/* Lost; the host sees the gap in the sample index. */
		stats.tx_failures++;
	}

	k_mutex_unlock(&tx_lock);
	return true;
}

/*
 * Sends full-width blocks as fast as the host takes them, so the result is
 * what the link sustains for the stream's worst case, independent of the
 * sampler; payload word k of a block is first + k. In pack mode the blocks
 * instead carry pseudo-random samples seeded by first + 1, packed like the
 * stream, for the host to check its decoder against.
 */
static void link_test_run(void)
{
	static const uint8_t full_width[PPK2_FIELD_COUNT] = PPK2_FIELD_BITS;
	struct sampling_block blk = {
		.count = PPK2_BLOCK_SAMPLES,
		.words = PPK2_BLOCK_PAYLOAD_WORDS(PPK2_BLOCK_SAMPLES, PPK2_SAMPLE_BITS_MAX),
	};
	struct net_buf *buf;
	int err;

	memcpy(blk.width, full_width, sizeof(blk.width));

	link_test_busy = true;

	while (link_test_active && k_uptime_get() < link_test_end) {
		k_mutex_lock(&tx_lock, K_FOREVER);
		buf = usb_ppk_data_alloc(BLOCK_BYTES_MAX, TX_BLOCK_TIMEOUT, &err);
		if (buf == NULL) {
			k_mutex_unlock(&tx_lock);
			if (err == -EAGAIN) {
				continue;
			}
			break;
		}

		uint32_t *payload = block_payload(buf);

		if (link_test_pack) {
			if (sampling_test_block(blk.first + 1U, payload, &blk) < 0) {
				/* The sampler has the ring (self-test). */
				usb_ppk_data_free(buf);
				k_mutex_unlock(&tx_lock);
				break;
			}
		} else {
			for (uint32_t k = 0; k < blk.words; k++) {
				payload[k] = blk.first + k;
			}
		}
		block_seal(buf, PPK2_BLOCK_TEST, &blk);
		if (usb_ppk_data_submit(buf) == 0) {
			stats.test_blocks++;
		}
		k_mutex_unlock(&tx_lock);
		blk.first += PPK2_BLOCK_SAMPLES;
	}

	k_mutex_lock(&tx_lock, K_FOREVER);
	buf = usb_ppk_data_alloc(BLOCK_HEADER_SIZE, TX_TEXT_TIMEOUT, &err);
	if (buf != NULL) {
		blk.count = 0;
		blk.words = 0;
		block_seal(buf, PPK2_BLOCK_TEST | PPK2_BLOCK_LAST, &blk);
		(void)usb_ppk_data_submit(buf);
	}
	k_mutex_unlock(&tx_lock);

	link_test_active = false;
	link_test_busy = false;
}

/*
 * Moves blocks from the sample ring to USB. After a stop it sends the tail
 * and the final block, then tells stream_stop() the stream is out.
 */
static void pump_thread(void *p1, void *p2, void *p3)
{
	ARG_UNUSED(p1);
	ARG_UNUSED(p2);
	ARG_UNUSED(p3);

	for (;;) {
		sampling_wait_block(K_MSEC(100));

		if (link_test_active) {
			link_test_run();
			continue;
		}

		while (pump_block()) {
		}

		if (streaming && sampling_drained()) {
			k_sem_give(&flushed);
		}
	}
}

K_THREAD_DEFINE(protocol_cmd_tid, 2048, command_thread, NULL, NULL, NULL,
		K_PRIO_PREEMPT(6), 0, 0);
K_THREAD_DEFINE(protocol_pump_tid, 2048, pump_thread, NULL, NULL, NULL,
		K_PRIO_PREEMPT(2), 0, 0);

int protocol_init(void)
{
	crc_init();
	usb_ppk_set_callbacks(rx_handler, link_handler);
	return 0;
}

bool protocol_streaming(void)
{
	return streaming;
}

void protocol_get_stats(struct protocol_stats *st)
{
	*st = stats;
}
```

## src/protocol.h
```c
/*
 * PPK2 host protocol on the USB data port.
 *
 * SPDX-License-Identifier: Apache-2.0
 */

#ifndef PROTOCOL_H_
#define PROTOCOL_H_

#include <stdbool.h>
#include <stdint.h>

struct protocol_stats {
	uint32_t commands;
	uint32_t unknown_bytes;
	/* Blocks that could not be queued, and waits for a free transfer slot
	 * that timed out because the host was not reading.
	 */
	uint32_t tx_failures;
	uint32_t tx_stalls;
	/* Stops whose tail did not reach the host in time. */
	uint32_t flush_timeouts;
	uint32_t bytes_sent;
	uint32_t test_blocks;
};

int protocol_init(void);

bool protocol_streaming(void);
void protocol_get_stats(struct protocol_stats *st);

#endif /* PROTOCOL_H_ */
```

## src/sampling.h
```c
/*
 * SAADC front end: the current + DUT-voltage stream and the slow monitors.
 *
 * SPDX-License-Identifier: Apache-2.0
 */

#ifndef SAMPLING_H_
#define SAMPLING_H_

#include <stdbool.h>
#include <stddef.h>
#include <stdint.h>
#include <zephyr/kernel.h>

#include "ppk2.h"

/* 16 MHz timer tick within each sample period at which the scan is triggered. */
#define SAMPLING_SAMPLE_TICK	112U

/* END-to-handler latency histogram, 1 us per bucket, last bucket open-ended. */
#define SAMPLING_LATENCY_BUCKETS	24

struct sampling_metrics {
	/* Samples handed to the host, and samples lost to ring overflow. */
	uint32_t samples_emitted;
	uint32_t samples_dropped;
	uint32_t overflows;
	/* Samples taken while the range switches were in transition. */
	uint32_t switch_samples;
	/* CPU cycles spent packing blocks, in total and for the worst block. */
	uint64_t pack_cycles;
	uint32_t pack_samples;
	uint32_t pack_cycles_max;
	uint32_t blocks_sent;
	/* SAADC END events counted in hardware (TIMER3) since the last start. */
	uint32_t end_events;
	/* Times the END interrupt actually ran. Fewer than end_events means
	 * conversions were lost to interrupt latency.
	 */
	uint32_t isr_entries;
	/* Entries that found no new scan and were ignored. */
	uint32_t isr_spurious;
	/* END events that passed between consecutive ISR entries without one
	 * of their own, and the largest such run.
	 */
	uint32_t isr_missed_ends;
	uint32_t isr_max_end_gap;
	/* Longest handler run seen, in 16 MHz ticks (160 per sample). */
	uint32_t isr_max_run_ticks;
	/* END event to handler entry, 16 MHz ticks, and its distribution. */
	uint32_t isr_max_latency_ticks;
	/* Earliest and latest scan end within the sample period, 16 MHz ticks
	 * after the period starts (SAMPLE fires at SAMPLING_SAMPLE_TICK).
	 */
	uint32_t isr_end_phase_min;
	uint32_t isr_end_phase_max;
	uint32_t isr_latency_hist[SAMPLING_LATENCY_BUCKETS];
};

/* Runs the sampler with nothing consuming the stream, then reports metrics.
 * With spin set the calling thread busy-waits instead of sleeping, which
 * keeps the CPU out of WFI for the duration. period is the sample period in
 * 16 MHz ticks (160 for the production rate).
 */
int sampling_selftest(uint32_t seconds, bool spin, uint32_t period, struct sampling_metrics *m);

enum sampling_channel {
	SAMPLING_CH_VSE_IA,	/* AIN7, instrumentation amplifier output */
	SAMPLING_CH_VREF_IA,	/* AIN0, instrumentation amplifier reference */
	SAMPLING_CH_VLDO,	/* AIN1, LDO output, /5 */
	SAMPLING_CH_VBB,	/* AIN2, buck-boost output, /5 */
	SAMPLING_CH_VIN,	/* AIN3, VIN terminal, /5 */
	SAMPLING_CH_VDUT,	/* AIN4, VDUT+, /5 */
	SAMPLING_CH_NTC,	/* AIN6, thermistor divider */
	SAMPLING_CH_COUNT,
};

int sampling_init(void);

int sampling_start(void);
void sampling_stop(void);
bool sampling_running(void);

/* Blocks until a block-sized run of samples is likely available. */
int sampling_wait_block(k_timeout_t timeout);

/* A block taken by sampling_take_block(): where it sits in the stream and
 * how its payload is packed (see ppk2.h).
 */
struct sampling_block {
	uint32_t first;		/* stream index of the first sample */
	uint16_t count;
	bool overflow;		/* samples right before this block were lost */
	bool last;		/* the stream has stopped; nothing follows */
	uint16_t base[PPK2_FIELD_COUNT];
	uint8_t width[PPK2_FIELD_COUNT];
	uint16_t words;		/* payload length in 32-bit words */
};

/*
 * True when sampling_take_block() has something to return: a full block
 * while the stream runs, the remainder and the final marker once it stopped.
 */
bool sampling_block_ready(void);

/*
 * Packs the next block into payload, which must hold
 * PPK2_BLOCK_PAYLOAD_WORDS(PPK2_BLOCK_SAMPLES, PPK2_SAMPLE_BITS_MAX) words.
 * When the reader has fallen too far behind, skips ahead first and flags
 * the block. Returns false if there is nothing to take; a stopped stream
 * yields one final block with last set, possibly empty.
 */
bool sampling_take_block(uint32_t *payload, struct sampling_block *blk);

/*
 * Packs a block of pseudo-random samples, seeded by seed, the way stream
 * blocks are packed, so a host can check the packing against its own copy
 * of the generator. Uses the ring, so only while no stream runs.
 */
int sampling_test_block(uint32_t seed, uint32_t *payload, struct sampling_block *blk);

/* Drops everything not taken yet, final marker included. */
void sampling_discard(void);

/* The stream has stopped and everything, final marker included, was taken. */
bool sampling_drained(void);

void sampling_get_metrics(struct sampling_metrics *m);
void sampling_reset_metrics(void);
void sampling_count_block_sent(void);

/* SAADC acquisition-time code for the stream (CONFIG.TACQ, 0..7). Takes
 * effect at the next start. Exposed for experiments; see STREAM_TACQ_CODE.
 */
int sampling_set_tacq(uint8_t code);
uint8_t sampling_get_tacq(void);

/* Same, for the voltage channel of the stream. */
int sampling_set_tacq_v(uint8_t code);
uint8_t sampling_get_tacq_v(void);

/*
 * One 256x oversampled conversion. Only while the stream is stopped.
 * The result is the voltage at the measured node, dividers included.
 */
int sampling_measure_mv(enum sampling_channel ch, float *mv);

/* Averaged raw 14-bit differential reading, for calibration work. */
int sampling_measure_raw(enum sampling_channel ch, unsigned int count, int32_t *raw_avg);

/* The stream's voltage word scale: mV = raw * full_scale_mv / 8192 * divider. */
void sampling_voltage_scale(float *full_scale_mv, float *divider);

#endif /* SAMPLING_H_ */
```

## src/usb_ppk.h
```c
/*
 * USB composite device: PPK2 data port, shell port and DFU trigger.
 *
 * SPDX-License-Identifier: Apache-2.0
 */

#ifndef USB_PPK_H_
#define USB_PPK_H_

#include <stdbool.h>
#include <stddef.h>
#include <stdint.h>
#include <zephyr/kernel.h>

/* Both callbacks run in USB stack context; keep them short. */
typedef void (*usb_ppk_rx_cb_t)(const uint8_t *data, size_t len);
typedef void (*usb_ppk_state_cb_t)(bool connected);

void usb_ppk_set_callbacks(usb_ppk_rx_cb_t rx, usb_ppk_state_cb_t state);

int usb_ppk_init(void);

/* The data port is configured and the host has raised DTR. */
bool usb_ppk_data_connected(void);

/*
 * Queues len bytes on the data port's bulk IN endpoint. Blocks for up to
 * timeout while all transfer slots are busy.
 */
int usb_ppk_data_send(const uint8_t *data, size_t len, k_timeout_t timeout);

struct net_buf;

/*
 * Zero-copy variant: reserves a transfer slot and a buffer of size bytes,
 * waiting up to timeout for a slot. Fill buf->data, net_buf_add() what was
 * written, then usb_ppk_data_submit() it, or hand it back unsent with
 * usb_ppk_data_free(). Returns NULL with *err set to -ENOTCONN, -EAGAIN
 * (no slot in time) or -ENOMEM.
 */
struct net_buf *usb_ppk_data_alloc(size_t size, k_timeout_t timeout, int *err);
int usb_ppk_data_submit(struct net_buf *buf);
void usb_ppk_data_free(struct net_buf *buf);

/* Drops every transfer still queued on the data port, sent or not. */
void usb_ppk_data_abort(void);

#endif /* USB_PPK_H_ */
```
